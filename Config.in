## Config.in
```kconfig
source "$BR2_EXTERNAL_FLIPBASE_PATH/package/libmali/Config.in"
source "$BR2_EXTERNAL_FLIPBASE_PATH/package/flipbase-sdl3/Config.in"
source "$BR2_EXTERNAL_FLIPBASE_PATH/package/flipbase-sdl3-image/Config.in"
source "$BR2_EXTERNAL_FLIPBASE_PATH/package/flipbase-sdl3-ttf/Config.in"
source "$BR2_EXTERNAL_FLIPBASE_PATH/package/flipbase-sdl3-mixer/Config.in"
source "$BR2_EXTERNAL_FLIPBASE_PATH/package/sdl2-compat/Config.in"
source "$BR2_EXTERNAL_FLIPBASE_PATH/package/flipbase-sdl2-image/Config.in"
source "$BR2_EXTERNAL_FLIPBASE_PATH/package/flipbase-sdl2-ttf/Config.in"
source "$BR2_EXTERNAL_FLIPBASE_PATH/package/flipbase-tools/Config.in"
source "$BR2_EXTERNAL_FLIPBASE_PATH/package/mesa-panfrost/Config.in"
source "$BR2_EXTERNAL_FLIPBASE_PATH/package/mali-kbase/Config.in"
source "$BR2_EXTERNAL_FLIPBASE_PATH/package/rtl8733bu/Config.in"
source "$BR2_EXTERNAL_FLIPBASE_PATH/package/stock-firmware/Config.in"
```

## package/flipbase-sdl2-ttf/Config.in
```kconfig
config BR2_PACKAGE_FLIPBASE_SDL2_TTF
	bool "flipbase-sdl2-ttf"
	depends on BR2_PACKAGE_SDL2_COMPAT
	select BR2_PACKAGE_FREETYPE
	help
	  SDL2_ttf against sdl2-compat; Buildroot's needs sdl2.
```

## package/flipbase-sdl3-image/Config.in
```kconfig
config BR2_PACKAGE_FLIPBASE_SDL3_IMAGE
	bool "flipbase-sdl3-image"
	depends on BR2_PACKAGE_FLIPBASE_SDL3
	select BR2_PACKAGE_LIBPNG
	select BR2_PACKAGE_JPEG
	select BR2_PACKAGE_WEBP
	select BR2_PACKAGE_WEBP_DEMUX # animated WebP
	select BR2_PACKAGE_WEBP_MUX # WebP save
	help
	  SDL3_image against flipbase-sdl3; Buildroot's needs its sdl3.
	  PNG, JPEG and WebP through the system libraries.
```

## package/flipbase-sdl3-mixer/Config.in
```kconfig
config BR2_PACKAGE_FLIPBASE_SDL3_MIXER
	bool "flipbase-sdl3-mixer"
	depends on BR2_PACKAGE_FLIPBASE_SDL3
	help
	  SDL3_mixer with its built-in decoders only: WAV, AIFF, VOC,
	  AU, FLAC, MP3, Ogg Vorbis and MIDI (Timidity).

	  https://github.com/libsdl-org/SDL_mixer
```

## package/flipbase-sdl3-ttf/Config.in
```kconfig
config BR2_PACKAGE_FLIPBASE_SDL3_TTF
	bool "flipbase-sdl3-ttf"
	depends on BR2_PACKAGE_FLIPBASE_SDL3
	select BR2_PACKAGE_FREETYPE
	select BR2_PACKAGE_HARFBUZZ
	help
	  SDL3_ttf against flipbase-sdl3; Buildroot's needs its sdl3.
	  HarfBuzz shapes complex and right-to-left scripts.
```

## package/flipbase-tools/Config.in
```kconfig
config BR2_PACKAGE_FLIPBASE_TOOLS
	bool "flipbase-tools"
	select BR2_PACKAGE_FREETYPE
	help
	  FlipBase's own programs, from src/: fbsplash, the GPT tools
	  for expand-to-fill and A/B updates, rebootmode, pwrkeyd,
	  fatdirty and wifibtd.
```

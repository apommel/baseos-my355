## Config.in
```kconfig
source "$BR2_EXTERNAL_BASEOS_PATH/package/libmali/Config.in"
source "$BR2_EXTERNAL_BASEOS_PATH/package/baseos-sdl3/Config.in"
source "$BR2_EXTERNAL_BASEOS_PATH/package/baseos-sdl3-image/Config.in"
source "$BR2_EXTERNAL_BASEOS_PATH/package/baseos-sdl3-ttf/Config.in"
source "$BR2_EXTERNAL_BASEOS_PATH/package/baseos-sdl3-mixer/Config.in"
source "$BR2_EXTERNAL_BASEOS_PATH/package/sdl2-compat/Config.in"
source "$BR2_EXTERNAL_BASEOS_PATH/package/baseos-sdl2-image/Config.in"
source "$BR2_EXTERNAL_BASEOS_PATH/package/baseos-sdl2-ttf/Config.in"
source "$BR2_EXTERNAL_BASEOS_PATH/package/baseos-tools/Config.in"
source "$BR2_EXTERNAL_BASEOS_PATH/package/mesa-panfrost/Config.in"
source "$BR2_EXTERNAL_BASEOS_PATH/package/mali-kbase/Config.in"
source "$BR2_EXTERNAL_BASEOS_PATH/package/rtl8733bu/Config.in"
source "$BR2_EXTERNAL_BASEOS_PATH/package/stock-firmware/Config.in"
```

## buildroot/Config.in
```kconfig
source "$BR2_EXTERNAL_BASEOS_PATH/package/libmali/Config.in"
source "$BR2_EXTERNAL_BASEOS_PATH/package/baseos-sdl3/Config.in"
source "$BR2_EXTERNAL_BASEOS_PATH/package/sdl2-compat/Config.in"
source "$BR2_EXTERNAL_BASEOS_PATH/package/baseos-sdl2-image/Config.in"
source "$BR2_EXTERNAL_BASEOS_PATH/package/baseos-sdl2-ttf/Config.in"
```

## buildroot/package/baseos-sdl2-ttf/Config.in
```kconfig
config BR2_PACKAGE_BASEOS_SDL2_TTF
	bool "baseos-sdl2-ttf"
	depends on BR2_PACKAGE_SDL2_COMPAT
	select BR2_PACKAGE_FREETYPE
	help
	  SDL2_ttf against sdl2-compat; Buildroot's needs sdl2.
```

## buildroot/package/baseos-sdl3-ttf/Config.in
```kconfig
config BR2_PACKAGE_BASEOS_SDL3_TTF
	bool "baseos-sdl3-ttf"
	depends on BR2_PACKAGE_BASEOS_SDL3
	select BR2_PACKAGE_FREETYPE
	select BR2_PACKAGE_HARFBUZZ
	help
	  SDL3_ttf against baseos-sdl3; Buildroot's needs its sdl3.
	  HarfBuzz shapes complex and right-to-left scripts.
```

## buildroot/package/baseos-sdl3/Config.in
```kconfig
config BR2_PACKAGE_BASEOS_SDL3
	bool "baseos-sdl3"
	depends on BR2_PACKAGE_HAS_LIBEGL
	depends on BR2_PACKAGE_HAS_LIBGLES
	depends on BR2_PACKAGE_HAS_LIBGBM
	depends on BR2_PACKAGE_HAS_LIBUDEV
	select BR2_PACKAGE_ALSA_LIB
	select BR2_PACKAGE_DBUS
	select BR2_PACKAGE_LIBDRM
	help
	  SDL3 for KMS/DRM with OpenGL ES, Vulkan, ALSA, udev, D-Bus
	  and HIDAPI: what stock's SDL2 had, which Buildroot's sdl3
	  package turns off.

	  https://www.libsdl.org/
```

## buildroot/package/libmali/Config.in
```kconfig
config BR2_PACKAGE_LIBMALI
	bool "libmali"
	depends on BR2_aarch64
	depends on BR2_TOOLCHAIN_USES_GLIBC
	depends on BR2_INSTALL_LIBSTDCPP
	select BR2_PACKAGE_HAS_LIBEGL
	select BR2_PACKAGE_HAS_LIBGLES
	select BR2_PACKAGE_HAS_LIBGBM
	select BR2_PACKAGE_LIBGBM_HAS_FEATURE_DMA_BUF
	select BR2_PACKAGE_LIBDRM
	help
	  Rockchip's G52 libmali (g29p1, libmali-next) with its EGL,
	  GLES, GBM and Vulkan wrappers and hook. The sources are a
	  sparse checkout build-userland.sh fetches: the branch carries
	  every Rockchip GPU's blobs.

if BR2_PACKAGE_LIBMALI

config BR2_PACKAGE_PROVIDES_LIBEGL
	default "libmali"

config BR2_PACKAGE_PROVIDES_LIBGLES
	default "libmali"

config BR2_PACKAGE_PROVIDES_LIBGBM
	default "libmali"

endif
```

## package/baseos-sdl2-image/Config.in
```kconfig
config BR2_PACKAGE_BASEOS_SDL2_IMAGE
	bool "baseos-sdl2-image"
	depends on BR2_PACKAGE_SDL2_COMPAT
	select BR2_PACKAGE_LIBPNG
	select BR2_PACKAGE_JPEG
	help
	  SDL2_image against sdl2-compat; Buildroot's needs sdl2.
	  PNG through libpng, as stock, and JPEG through libjpeg-turbo.
```

## package/baseos-sdl3-image/Config.in
```kconfig
config BR2_PACKAGE_BASEOS_SDL3_IMAGE
	bool "baseos-sdl3-image"
	depends on BR2_PACKAGE_BASEOS_SDL3
	select BR2_PACKAGE_LIBPNG
	select BR2_PACKAGE_JPEG
	select BR2_PACKAGE_WEBP
	select BR2_PACKAGE_WEBP_DEMUX # animated WebP
	select BR2_PACKAGE_WEBP_MUX # WebP save
	help
	  SDL3_image against baseos-sdl3; Buildroot's needs its sdl3.
	  PNG, JPEG and WebP through the system libraries.
```

## package/baseos-sdl3-mixer/Config.in
```kconfig
config BR2_PACKAGE_BASEOS_SDL3_MIXER
	bool "baseos-sdl3-mixer"
	depends on BR2_PACKAGE_BASEOS_SDL3
	help
	  SDL3_mixer with its built-in decoders only: WAV, AIFF, VOC,
	  AU, FLAC, MP3, Ogg Vorbis and MIDI (Timidity).

	  https://github.com/libsdl-org/SDL_mixer
```

## package/baseos-tools/Config.in
```kconfig
config BR2_PACKAGE_BASEOS_TOOLS
	bool "baseos-tools"
	select BR2_PACKAGE_FREETYPE
	help
	  BaseOS's own programs, from src/: fbsplash, the GPT tools
	  for expand-to-fill and A/B updates, rebootmode, pwrkeyd,
	  fatdirty and wifibtd.
```

## package/mali-kbase/Config.in
```kconfig
config BR2_PACKAGE_MALI_KBASE
	bool "mali-kbase"
	depends on BR2_LINUX_KERNEL
	help
	  ROCKNIX's Arm Mali kbase driver (r54p2), the kernel side
	  of libmali.

	  https://github.com/rocknix/mali_kbase
```

## package/mesa-panfrost/Config.in
```kconfig
config BR2_PACKAGE_MESA_PANFROST
	bool "mesa-panfrost"
	depends on BR2_aarch64
	depends on BR2_INSTALL_LIBSTDCPP
	depends on BR2_TOOLCHAIN_HAS_THREADS_NPTL
	select BR2_PACKAGE_EXPAT
	select BR2_PACKAGE_LIBDRM
	select BR2_PACKAGE_ZLIB
	help
	  Mesa's Panfrost and PanVK in /usr/lib/mesa, beside libmali,
	  which stays the EGL, GLES and GBM provider; baseos-gpu
	  picks one at boot. Buildroot's mesa3d would provide them
	  and need LLVM on the target.
```

## package/rtl8733bu/Config.in
```kconfig
config BR2_PACKAGE_RTL8733BU
	bool "rtl8733bu"
	depends on BR2_LINUX_KERNEL
	help
	  The RTL8733BU's WiFi driver (8733bu.ko).

	  https://github.com/Charliechen114514/rtl8733bu-linux-driver
```

## package/sdl2-compat/Config.in
```kconfig
config BR2_PACKAGE_SDL2_COMPAT
	bool "sdl2-compat"
	depends on BR2_PACKAGE_BASEOS_SDL3
	help
	  SDL2's ABI, libSDL2-2.0.so.0, implemented over SDL3.

	  https://github.com/libsdl-org/sdl2-compat
```

## package/stock-firmware/Config.in
```kconfig
config BR2_PACKAGE_STOCK_FIRMWARE
	bool "stock-firmware"
	help
	  From the stock firmware: the vendor U-Boot FIT (mtd1), whose
	  BL31, OP-TEE and control tree the card's U-Boot carries, and
	  the RTL8733BU's Bluetooth firmware, which has no other source.
	  Set STOCK_FIRMWARE_OVERRIDE_SRCDIR to a directory holding
	  uboot.img and stock-harvest.tar from your own dump.
```
